## sdkconfig.defaults
```kconfig
CONFIG_IDF_TARGET_ESP32S3=y
CONFIG_ESP32S3_DEFAULT_CPU_FREQ_240=y
CONFIG_ESPTOOLPY_FLASHMODE_QIO=y
CONFIG_ESPTOOLPY_FLASHSIZE_8MB=y

# I2S PCM5102A
CONFIG_EXAMPLE_I2S_BCK_GPIO=42
CONFIG_EXAMPLE_I2S_WS_GPIO=38
CONFIG_EXAMPLE_I2S_DO_GPIO=40

# SSD1306 OLED SDA=8 SCL=9
CONFIG_EXAMPLE_OLED_SDA_GPIO=8
CONFIG_EXAMPLE_OLED_SCL_GPIO=9

CONFIG_LWIP_MAX_SOCKETS=16
CONFIG_WIFI_SSID=""
CONFIG_WIFI_PASSWORD=""

CONFIG_LV_USE_DISPLAY=y
CONFIG_LV_TICK_PERIOD_MS=10
CONFIG_LV_USE_LOG=n
```
